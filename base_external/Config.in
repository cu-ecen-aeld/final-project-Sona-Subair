## base_external/Config.in
```kconfig
source "$BR2_EXTERNAL_project_base_PATH/package/beagleboneblack_i2c_driver/Config.in"
```

## base_external/package/beagleboneblack_i2c_driver/Config.in
```kconfig
config BR2_PACKAGE_BEAGLEBONEBLACK_I2C_DRIVER
	bool "beagleboneblack_i2c_driver"
	help
	  Includes the sample I2C driver for beaglebone
```

## base_external/package/beagleboneblack_uart_driver/Config.in
```kconfig
config BR2_PACKAGE_BEAGLEBONEBLACK_UART_DRIVER
	bool "beagleboneblack_uart_driver"
	help
	  Includes uart driver in the kernel image.
	  Used to understand buildroot external trees and package builds.
```

## base_external/package/client/Config.in
```kconfig
config BR2_CLIENT
        bool "client"
        help
          Includes client  code .
```

## base_external/package/ldd/Config.in
```kconfig
config BR2_PACKAGE_LDD
	bool "ldds"
	help
	  Includes the mis-modules and scull modules in the kernel image.
	  Used to understand buildroot external trees and package builds.
```

## base_external/package/mma8452q_application_code/Config.in
```kconfig
config BR2_PACKAGE_MMA8452Q_APPLICATION_CODE
	bool "mma8452q_application_code"
	help
	  Includes accelerometer application code for MMA8452Q.
```

## buildroot_client/base_external/package/client/Config.in
```kconfig
config BR2_PACKAGE_CLIENT
        bool "client"
        help
          Includes client  code .
```

## buildroot_server/base_external/package/gps_application_code/Config.in
```kconfig
config BR2_PACKAGE_GPS_APPLICATION_CODE
        bool "gps_application_code"
        help
          Includes accelerometer application code for GPS.
```

## buildroot_server/base_external/package/server/Config.in
```kconfig
config BR2_PACKAGE_SERVER
        bool "server"
        help
          Includes the server for beaglebone
```
